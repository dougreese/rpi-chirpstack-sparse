## os-build/build/conf/bblayers.conf
```bitbake
# POKY_BBLAYERS_CONF_VERSION is increased each time build/conf/bblayers.conf
# changes incompatibly
POKY_BBLAYERS_CONF_VERSION = "2"

BBPATH = "${TOPDIR}"
BBFILES ?= ""

BBLAYERS ?= " \
  /home/${USER}/os-build/layers/poky/meta \
  /home/${USER}/os-build/layers/poky/meta-poky \
  /home/${USER}/os-build/layers/poky/meta-yocto-bsp \
  /home/${USER}/os-build/layers/meta-openembedded/meta-oe \
  /home/${USER}/os-build/layers/meta-openembedded/meta-multimedia \
  /home/${USER}/os-build/layers/meta-openembedded/meta-networking \
  /home/${USER}/os-build/layers/meta-openembedded/meta-python \
  /home/${USER}/os-build/layers/meta-raspberrypi \
  /home/${USER}/os-build/layers/meta-clang \
  /home/${USER}/os-build/layers/meta-chirpstack \
  "
```

## os-build/layers/meta-chirpstack/conf/layer.conf
```bitbake
BBPATH .= ":${LAYERDIR}"

# We have recipes-* directories, add to BBFILES
BBFILES += "${LAYERDIR}/chirpstack/meta/recipes-*/*/*.bb \
            ${LAYERDIR}/chirpstack/meta/recipes-*/*/*.bbappend"

BBFILE_COLLECTIONS += "meta-chirpstack"
BBFILE_PATTERN_meta-chirpstack = "^${LAYERDIR}/"
BBFILE_PRIORITY_meta-chirpstack = "6"

LAYERDEPENDS_meta-chirpstack = "core"
LAYERSERIES_COMPAT_meta-chirpstack = "hardknott honister"
```
